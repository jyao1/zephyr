## boards/x86/uefi_payload/Kconfig.board
```kconfig
# SPDX-License-Identifier: Apache-2.0

config BOARD_UEFI_PAYLOAD_IA32
	bool "UEFI PAYLOAD IA32"
	depends on SOC_IA32
	select QEMU_TARGET
	select HAS_COVERAGE_SUPPORT

config BOARD_UEFI_PAYLOAD_X64
	bool "UEFI PAYLOAD X64"
	depends on SOC_IA32
	select QEMU_TARGET
	select X86_64
```

## boards/x86/uefi_payload/Kconfig.defconfig
```kconfig
# SPDX-License-Identifier: Apache-2.0

if BOARD_UEFI_PAYLOAD_IA32

config BUILD_OUTPUT_BIN
	default n

config BOARD
	default "uefi_payload_ia32"

config FLASH_SIMULATOR
	default y
	depends on FLASH

endif # BOARD_UEFI_PAYLOAD_IA32

config BOARD
	default "uefi_payload_x64"
	depends on BOARD_UEFI_PAYLOAD_X64
```
